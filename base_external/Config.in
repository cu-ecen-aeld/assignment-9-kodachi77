## base_external/Config.in
```kconfig
source "$BR2_EXTERNAL_PROJECT_ROOT_PATH/package/aesd-assignments/Config.in"
source "$BR2_EXTERNAL_PROJECT_ROOT_PATH/package/ldd/Config.in"
```

## base_external/package/aesd-char-driver/Config.in
```kconfig
config BR2_PACKAGE_AESD_CHAR_DRIVER
	bool "aesd-char-driver"
	help
	  Implementation of AESD Char Driver.
```
